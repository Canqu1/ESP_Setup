#include <Arduino.h>
#include <SPI.h>       // Cần cho giao tiếp SPI
#include <TFT_eSPI.h>
#include <Wire.h>      // Cần cho giao tiếp I2C
#include <Pcf8575.h>   // Thư viện PCF8574
#include <LCD_ECU.h>   // Thư viện LCD_ECU
PCF8575 pcf8575(0x20); 
// Thư viện TFT_eSPI
TFT_eSPI tft = TFT_eSPI();
int trangHienTai = 1;
int mucMenu = 1;
volatile boolean NUT_NHAN = false; // Cờ tổng hợp: true nếu có nút được nhấn

#define INT_PIN 0 // Chân GPIO của ESP32 kết nối với chân INT của PCF8575




 boolean trangThaiNutLen = false;
 boolean trangThaiNutOk = false;
 boolean trangThaiNutXuong = false;
 boolean trangThaiNutBack = false;

 boolean trangThaiCuoiNutLen = false;
 boolean trangThaiCuoiNutOk = false;
 boolean trangThaiCuoiNutXuong = false;
 boolean trangThaiCuoiNutBack = false;

 boolean LEN = false;
 boolean OKE = false;
 boolean XUONG = false;
 boolean BACK = false;
#define nutLen   P0
#define nutOk    P1
#define nutXuong P2
#define nutBack  P3
void khiNutLenDuocNhan() {
  if (trangThaiNutLen != trangThaiCuoiNutLen) {
    if (trangThaiNutLen == 0) {
      LEN = true;
    }
  }
  trangThaiCuoiNutLen = trangThaiNutLen;
}

void khiNutOkDuocNhan() {
  if (trangThaiNutOk != trangThaiCuoiNutOk) {
    if (trangThaiNutOk == 0) {
      OKE = true;
    }
  }
  trangThaiCuoiNutOk = trangThaiNutOk;
}

void khiNutXuongDuocNhan() {
  if (trangThaiNutXuong != trangThaiCuoiNutXuong) {
    if (trangThaiNutXuong == 0) {
      XUONG = true;
    }
  }
  trangThaiCuoiNutXuong = trangThaiNutXuong;
}

void khiNutBackDuocNhan() {
  if (trangThaiNutBack != trangThaiCuoiNutBack) {
    if (trangThaiNutBack == 0) {
      BACK = true;
    }
  }
  trangThaiCuoiNutBack = trangThaiNutBack;
}


int loop_botton(int &trangHienTai ,int &mucMenu ) {
    
  trangThaiNutLen   = pcf8575.digitalRead(nutLen);
  trangThaiNutOk    = pcf8575.digitalRead(nutOk);
  trangThaiNutXuong = pcf8575.digitalRead(nutXuong);
  trangThaiNutBack  = pcf8575.digitalRead(nutBack);

  khiNutLenDuocNhan();
  khiNutOkDuocNhan();
  khiNutXuongDuocNhan();
  khiNutBackDuocNhan();
    // Xử lý nút lên
    if (LEN) {
      LEN = false;
      if (mucMenu == 0) {
        trangHienTai--; // Chuyển trang trước
        if (trangHienTai < 1) trangHienTai = 5; // Quay lại trang 5 nếu nhỏ hơn 1
      } 
      else { // mucMenu > 0
        mucMenu--;
        if (mucMenu < 1) mucMenu = 4; // Quay lại 4 nếu nhỏ hơn 1
      }
    }
  
    // Xử lý nút xuống
    if (XUONG) {
      XUONG = false;
      if (mucMenu == 0) {
        trangHienTai++; // Chuyển trang sau
        if (trangHienTai > 5) trangHienTai = 1; // Quay lại 1 nếu lớn hơn 5
      } 
      else { // mucMenu > 0
        mucMenu++;
        if (mucMenu > 4) mucMenu = 1; // Quay lại 1 nếu lớn hơn 4
      }
    }
  
    // Xử lý nút OK
    if (OKE) {
      OKE = false;
      if (mucMenu == 0) {
        mucMenu = 1; // Khi mucMenu = 0, nhấn OK sẽ vào mucMenu 1 của trang hiện tại
      }
      else { // mucMenu > 0, xử lý chức năng cho từng trang và mucMenu
        switch (trangHienTai) {
          case 1: // Trang 1
            switch (mucMenu) {
              case 1:
                // Chức năng Trang 1, Menu 1
                // Ví dụ: Serial.println("Trang 1, Menu 1");
                break;
              case 2:
                // Chức năng Trang 1, Menu 2
                // Ví dụ: Serial.println("Trang 1, Menu 2");
                break;
              case 3:
                // Chức năng Trang 1, Menu 3
                // Ví dụ: Serial.println("Trang 1, Menu 3");
                break;
              case 4:
                // Chức năng Trang 1, Menu 4
                // Ví dụ: Serial.println("Trang 1, Menu 4");
                break;
            }
            break;
  
          case 2: // Trang 2
            switch (mucMenu) {
              case 1:
                // Chức năng Trang 2, Menu 1
                break;
              case 2:
                // Chức năng Trang 2, Menu 2
                break;
              case 3:
                // Chức năng Trang 2, Menu 3
                break;
              case 4:
                // Chức năng Trang 2, Menu 4
                break;
            }
            break;
  
          case 3: // Trang 3
            switch (mucMenu) {
              case 1:
                // Chức năng Trang 3, Menu 1
                break;
              case 2:
                // Chức năng Trang 3, Menu 2
                break;
              case 3:
                // Chức năng Trang 3, Menu 3
                break;
              case 4:
                // Chức năng Trang 3, Menu 4
                break;
            }
            break;
  
          case 4: // Trang 4
            switch (mucMenu) {
              case 1:
                // Chức năng Trang 4, Menu 1
                break;
              case 2:
                // Chức năng Trang 4, Menu 2
                break;
              case 3:
                // Chức năng Trang 4, Menu 3
                break;
              case 4:
                // Chức năng Trang 4, Menu 4
                break;
            }
            break;
  
          case 5: // Trang 5
            switch (mucMenu) {
              case 1:
                // Chức năng Trang 5, Menu 1
                break;
              case 2:
                // Chức năng Trang 5, Menu 2
                break;
              case 3:
                // Chức năng Trang 5, Menu 3
                break;
              case 4:
                // Chức năng Trang 5, Menu 4
                break;
            }
            break;
        }
      }
    }
  
    // Xử lý nút Back
    if (BACK) {
      BACK = false;
      if (mucMenu > 0) {
        mucMenu = 0; // Khi mucMenu > 0, chỉ reset mucMenu về 0, giữ nguyên trangHienTai
      }
      // Nếu mucMenu == 0, không làm gì cả
    }
  
    delay(100);
    return trangHienTai, mucMenu;
  }
  
  // Các hàm xử lý sự kiện nút bấm giữ nguyên


  static const unsigned char PROGMEM OKAI[] = {0x00,0x00,0x00,0x00,0x00,0x00,0x00,0x00,0x00,0x00,0x00,0x00,0x00,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0x00,0x00};
  static const unsigned char PROGMEM DONGHOCAT[] = {0xff,0xe0,0x40,0x40,0x40,0x40,0x51,0x40,0x5f,0x40,0x2e,0x80,0x15,0x00,0x0a,0x00,0x0a,0x00,0x11,0x00,0x24,0x80,0x44,0x40,0x4e,0x40,0x5f,0x40,0x7f,0xc0,0xff,0xe0};
  static const unsigned char PROGMEM FOLDER[] = {0x3c,0x00,0x00,0x42,0x00,0x00,0x81,0xff,0x00,0x80,0x00,0x80,0xbf,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0xff,0x00};
  static const unsigned char PROGMEM PROGRAM[] = {0x07,0xc0,0x18,0x30,0x20,0x08,0x40,0x04,0x4c,0x04,0x8b,0x82,0x88,0x62,0x88,0x1a,0x88,0x62,0x8b,0x82,0x4c,0x04,0x40,0x04,0x20,0x08,0x18,0x30,0x07,0xc0,0x00,0x00};
  static const unsigned char PROGMEM DOWNLOAD[] = {0x00,0x00,0x00,0x07,0xc0,0x00,0x08,0x20,0x00,0x10,0x10,0x00,0x30,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0x00,0x00};
  static const unsigned char PROGMEM SETTING[] = {0x03,0xc0,0x12,0x48,0x2c,0x34,0x40,0x02,0x23,0xc4,0x24,0x24,0xc8,0x13,0x88,0x11,0x88,0x11,0xc8,0x13,0x24,0x24,0x23,0xc4,0x40,0x02,0x2c,0x34,0x12,0x48,0x03,0xc0};
  static const unsigned char PROGMEM BATTERY[] = {0x00,0x00,0x00,0x00,0x00,0x00,0x7f,0xff,0xf0,0x80,0x00,0x08,0xaa,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0x00,0x00};
  static const unsigned char PROGMEM BLUETOOTH[] = {0x01,0x00,0x02,0x80,0x02,0x40,0x22,0x20,0x12,0x20,0x0a,0x40,0x06,0x80,0x03,0x00,0x06,0x80,0x0a,0x40,0x12,0x20,0x22,0x20,0x02,0x40,0x02,0x80,0x01,0x00,0x00,0x00};
  static const unsigned char PROGMEM CONNECT[] = {0x00,0x00,0x00,0x00,0x00,0x00,0x20,0x02,0x00,0x40,0x01,0x00,0x48,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0x00,0x00};
  static const unsigned char PROGMEM WIFI[] = {0x01,0xf0,0x00,0x07,0xfc,0x00,0x1e,0x0f,0x00,0x39,0xf3,0x80,0x77,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0x00,0x00};
  static const unsigned char PROGMEM MUITEN[] = {0x01,0x80,0x01,0x40,0x01,0x20,0xff,0x50,0x80,0x68,0xbf,0xf4,0xaa,0xfa,0xb5,0x7a,0xbf,0xf4,0x80,0x68,0xff,0x50,0x01,0x20,0x01,0x40,0x01,0x80};
  
  static const unsigned char PROGMEM SETTING_HIGHLIGHT[] = {0x00,0x00,0x00,0x00,0x00,0x7f,0xff,0xff,0xff,0xc0,0x7f,0xff,0xff,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0x00,0x00};
  static const unsigned char PROGMEM DOWNLOAD_HIGHLIGHT[] = {0x00,0x00,0x00,0x00,0x7f,0xff,0xff,0xfe,0x7f,0xff,0xff,0xfe,0x7f,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0x00,0x00};
  static const unsigned char PROGMEM CONNECT_HIGHLIGHT[] = {0x00,0x00,0x00,0x00,0x7f,0xff,0xff,0xfe,0x7f,0xff,0xff,0xfe,0x7f,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0x00,0x00};
  static const unsigned char PROGMEM PROGRAM_HIGHLIGHT[] = {0x00,0x00,0x00,0x00,0x7f,0xff,0xff,0xfe,0x7f,0xff,0xff,0xfe,0x7f,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0x00,0x00};
  static const unsigned char PROGMEM FOLDER_HIGHLIGHT[] = {0x00,0x00,0x00,0x00,0x7f,0xff,0xff,0xfe,0x7f,0xff,0xff,0xfe,0x7f,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0x00,0x00};

  // //Định nghĩa chân cho ST7735 (ESP32 ví dụ)
  
  int x[5] = {6, 6, 6, 6 }; // Tọa độ x cho 5 dòng
  int y[5] = {49, 69, 89, 109}; // Tọa độ y cho 5 dòng (cách nhau 15 pixel)
  
  // Mảng buffer cho từng menu
  char buffer_menu1[5][20] = {"Temperature", "Light Sensor", "Motor Control", "LED Blink"};
  char buffer_menu2[5][20] = {"Run Program", "Pause Program", "Stop Program", "Reset Device"};
  char buffer_menu3[5][20] = {"Connect Wi-Fi", "Bluetooth Pair", "Send Data", "Disconnect"};
  char buffer_menu4[5][20] = {"Lessons", "Code Samples", "Firmware Update", "Offline Mode"};
  char buffer_menu5[5][20] = {"Brightness", "Sleep Timer", "Learning Mode", "Factory Reset"};
  
  char (*buffers[5])[20] = {buffer_menu1, buffer_menu2, buffer_menu3, buffer_menu4, buffer_menu5};
  void IRAM_ATTR ISR_PCF8575() {
    // Chỉ kiểm tra các chân nút nhấn (P0-P3), không quan tâm cảm biến (P4-P7)
    if (!pcf8575.digitalRead(nutLen) || !pcf8575.digitalRead(nutOk) ||
        !pcf8575.digitalRead(nutXuong) || !pcf8575.digitalRead(nutBack)) {
        NUT_NHAN = true; // Đặt cờ chỉ khi có nút nhấn
    }
    // Ngắt từ cảm biến (P4-P7) không ảnh hưởng đến NUT_NHAN
  }
  void menu(int menu, int line ) {
    pinMode(INT_PIN, INPUT_PULLUP);
      if (menu >= 1 && menu <= 5) { // Kiểm tra menu hợp lệ
          // Thiết lập phông chữ một lần
          tft.fillScreen(TFT_BLACK);
          tft.drawRect(1, 16, 159, 112, 0xFFFF);
  
          tft.drawRect(1, 16, 32, 31, 0xFFFF);
          
          
          tft.drawRect(94, 16, 32, 31, 0xFFFF);
          
          tft.drawRect(63, 16, 32, 31, 0xFFFF);
          
          tft.drawRect(32, 16, 32, 31, 0xFFFF);
          
          
          tft.drawRect(125, 16, 35, 31, 0xFFFF);
  
          // tft.drawBitmap(9, 23, FOLDER, 17, 16, 0xFFFF);
          // tft.drawBitmap(41, 23, PROGRAM, 15, 16, 0xFFFF);
          // tft.drawBitmap(102, 23, DOWNLOAD, 17, 16, 0xFFFF);
          // tft.drawBitmap(70, 23, CONNECT, 17, 16, 0xFFFF);
          // tft.drawBitmap(135, 23, SETTING, 16, 16, 0xFFFF);
  
          tft.drawBitmap(131, 0, BATTERY, 24, 16, 0xFFFF);
          
          tft.drawBitmap(95, 0, BLUETOOTH, 14, 16, 0xFFFF);
          
          tft.drawBitmap(109, 0, WIFI, 19, 16, 0xFFFF);
          if (menu == 1) {
              tft.drawBitmap(1, 16, FOLDER_HIGHLIGHT, 32, 31, 0xFFFF);
              tft.drawBitmap(41, 23, PROGRAM, 15, 16, 0xFFFF);
              tft.drawBitmap(102, 23, DOWNLOAD, 17, 16, 0xFFFF);
              tft.drawBitmap(70, 23, CONNECT, 17, 16, 0xFFFF);
              tft.drawBitmap(135, 23, SETTING, 16, 16, 0xFFFF);
          } 
          else if (menu == 2) {
              tft.drawBitmap(9, 23, FOLDER, 17, 16, 0xFFFF);
              tft.drawBitmap(32, 16, PROGRAM_HIGHLIGHT, 32, 31, 0xFFFF);
              tft.drawBitmap(102, 23, DOWNLOAD, 17, 16, 0xFFFF);
              tft.drawBitmap(70, 23, CONNECT, 17, 16, 0xFFFF);
              tft.drawBitmap(135, 23, SETTING, 16, 16, 0xFFFF);
          } 
          else if (menu == 4) {
              tft.drawBitmap(9, 23, FOLDER, 17, 16, 0xFFFF);
              tft.drawBitmap(41, 23, PROGRAM, 15, 16, 0xFFFF);
              tft.drawBitmap(94, 16, DOWNLOAD_HIGHLIGHT, 32, 31, 0xFFFF);
              tft.drawBitmap(70, 23, CONNECT, 17, 16, 0xFFFF);
              tft.drawBitmap(135, 23, SETTING, 16, 16, 0xFFFF);
          } 
          else if (menu == 3) {
              tft.drawBitmap(9, 23, FOLDER, 17, 16, 0xFFFF);
              tft.drawBitmap(41, 23, PROGRAM, 15, 16, 0xFFFF);
              tft.drawBitmap(102, 23, DOWNLOAD, 17, 16, 0xFFFF);
              tft.drawBitmap(63, 16, CONNECT_HIGHLIGHT, 32, 31, 0xFFFF);
              tft.drawBitmap(135, 23, SETTING, 16, 16, 0xFFFF);
          } 
          else if (menu == 5) {
              tft.drawBitmap(9, 23, FOLDER, 17, 16, 0xFFFF);
              tft.drawBitmap(41, 23, PROGRAM, 15, 16, 0xFFFF);
              tft.drawBitmap(102, 23, DOWNLOAD, 17, 16, 0xFFFF);
              tft.drawBitmap(70, 23, CONNECT, 17, 16, 0xFFFF);
              tft.drawBitmap(125, 16, SETTING_HIGHLIGHT, 35, 31, 0xFFFF);
          }
          tft.setTextSize(1);
          tft.setFreeFont(&FreeSans9pt7b);
  
          // Chọn buffer tương ứng với menu
          char (*current_buffer)[20] = buffers[menu - 1];
          // Vẽ toàn bộ menu
          for (int i = 0; i < 4; i++) {
              tft.drawString(current_buffer[i], x[i], y[i]);
          }
          
          // Vẽ dòng được chọn
          if (line >= 1 && line <= 4) {
              int index = line - 1;
              tft.fillRect(x[index], y[index] - 1, 100, 15, 0x0000); // Xóa khung cũ
              tft.drawString(current_buffer[index], x[index] + 21, y[index]); // Vẽ lại text với offset
              tft.drawBitmap(x[index], y[index], MUITEN, 15, 14, 0xFFFF); // Vẽ mũi tên
          }
      }
  }
  
  void lcd_setup() {
 
pcf8575.begin(0x20);
pcf8575.pinMode( nutLen, INPUT_PULLUP);
pcf8575.pinMode( nutXuong, INPUT_PULLUP);
pcf8575.pinMode( nutOk, INPUT_PULLUP);
pcf8575.pinMode( nutBack, INPUT_PULLUP);

    tft.init();
    tft.fillScreen(TFT_BLACK);
    tft.setRotation(5);
    
    // Vẽ khung viền ngoài
    tft.drawRect(0, 0, 160, 126, 0xFFFF);
  
    // Vẽ logo OKAI
    tft.drawBitmap(13, 24, OKAI, 131, 43, 0xFABF);
  
    // Vẽ text "OKAI - Make Life Better"
    tft.setTextColor(0x57FF);
    tft.setTextSize(1);
    tft.setFreeFont();
    tft.drawString("OKAI - Make Life Better", 11, 67);
  
    // Vẽ khung cho thanh tiến trình
    tft.drawRect(35, 91, 91, 16, 0xFFFF);
  
    // Vẽ text "Progress:"
    tft.setTextColor(0xFFFF);
    tft.drawString("Progress:", 49, 110);
  
    // Vẽ biểu tượng đồng hồ cát
    tft.drawBitmap(17, 91, DONGHOCAT, 11, 16, 0xFFFF);
  
    // Chạy thanh tiến trình từ 0% đến 100%
    for (int percent = 0; percent <= 100; percent++) {
      // Xóa phần trăm cũ
      tft.fillRect(104, 110, 30, 8, TFT_BLACK); // Xóa vùng phần trăm trước đó
      
      // Vẽ phần trăm mới
      tft.setTextColor(0xFFFF);
      tft.drawString(String(percent) + "%", 104, 110);
  
      // Tính toán chiều rộng của thanh tiến trình (91 là chiều rộng tối đa của khung)
      int progressWidth = map(percent, 0, 100, 0, 91); // Chuyển đổi từ 0-100% sang 0-91 pixel
      
      // Xóa thanh tiến trình cũ và vẽ thanh mới
      tft.fillRect(36, 92, 89, 14, TFT_BLACK); // Xóa bên trong khung trước khi vẽ lại
      tft.fillRect(36, 92, progressWidth, 14, 0x57FF); // Vẽ thanh tiến trình với màu xanh
  
      delay(50); // Điều chỉnh tốc độ chạy (50ms mỗi bước)
    }
  
  }
  
  void lcd_loop() {

      static int trangHienTai = 1 ;
      static int mucMenu = 0 ;
      static int trangHienTai_now = trangHienTai;
      static int mucMenu_now = mucMenu;
      loop_botton(trangHienTai, mucMenu);
      menu(trangHienTai , mucMenu );
      while (true) {
        // Khi có ngắt từ nút nhấn (NUT_NHAN = true)
        while (NUT_NHAN) {
            loop_botton(trangHienTai, mucMenu);
            if (trangHienTai_now != trangHienTai || mucMenu_now != mucMenu) {
                trangHienTai_now = trangHienTai;
                mucMenu_now = mucMenu;
                menu(trangHienTai, mucMenu); // Cập nhật màn hình
            }
            NUT_NHAN = false; // Reset cờ sau khi xử lý
        }
      }
  }
  
  